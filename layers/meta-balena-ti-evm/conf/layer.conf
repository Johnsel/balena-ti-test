## layers/meta-balena-ti-evm/conf/layer.conf
```bitbake
BBPATH .= ":${LAYERDIR}"

BBFILES += "${LAYERDIR}/recipes-*/*/*.bb \
            ${LAYERDIR}/recipes-*/*/*.bbappend"

BBFILE_COLLECTIONS += "balena-ti-evm"
BBFILE_PATTERN_balena-ti-evm := "^${LAYERDIR}/"
BBFILE_PRIORITY_balena-ti-evm = "1337"

LAYERDEPENDS_balena-ti-evm = "core"
LAYERDEPENDS_balena-ti-evm += "openembedded-layer"
LAYERDEPENDS_balena-ti-evm += "networking-layer"
LAYERDEPENDS_balena-ti-evm += "balena-common"
LAYERDEPENDS_balena-ti-evm += "balena-thud"
LAYERDEPENDS_balena-ti-evm += "meta-ti"

PREFERRED_PROVIDER_virtual/kernel_ti-evm = "linux-ti-staging"
PREFERRED_PROVIDER_virtual/bootloader_ti-evm = "u-boot"
PREFERRED_PROVIDER_u-boot_ti-evm = "u-boot"
```

## layers/meta-balena-ti-evm/conf/machine/ti-evm.conf
```bitbake
#@TYPE: Machine
#@NAME: BeagleBoard-XM
#@DESCRIPTION: Machine configuration for the BeagleBoard-XM

MACHINEOVERRIDES = "ti-evm:${MACHINE}"

include conf/machine/am335x-evm.conf
```
